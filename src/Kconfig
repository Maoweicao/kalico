## src/Kconfig
```kconfig
# Main Kconfig settings

mainmenu "Klipper Firmware Configuration"

config LOW_LEVEL_OPTIONS
    bool "Enable extra low-level configuration options"
    help
        Enable low-level configuration options that (if modified) may
        result in a build that does not function correctly.

choice
    prompt "Micro-controller Architecture"
    config MACH_AVR
        bool "Atmega AVR"
    config MACH_ATSAM
        bool "SAM3/SAM4/SAM E70"
    config MACH_ATSAMD
        bool "SAMC21/SAMD21/SAMD51/SAME5x"
    config MACH_LPC176X
        bool "LPC176x"
    config MACH_STM32
        bool "STMicroelectronics STM32"
    config MACH_HC32F460
        bool "Huada Semiconductor HC32F460"
    config MACH_RPXXXX
        bool "Raspberry Pi RP2040/RP235x"
    config MACH_PRU
        bool "Beaglebone PRU"
    config MACH_AR100
        bool "Allwinner A64 AR100"
    config MACH_LINUX
        bool "Linux process"
    config MACH_SIMU
        bool "Host simulator"
endchoice

source "src/avr/Kconfig"
source "src/atsam/Kconfig"
source "src/atsamd/Kconfig"
source "src/lpc176x/Kconfig"
source "src/stm32/Kconfig"
source "src/hc32f460/Kconfig"
source "src/rp2040/Kconfig"
source "src/pru/Kconfig"
source "src/ar100/Kconfig"
source "src/linux/Kconfig"
source "src/simulator/Kconfig"

# Generic configuration options for serial ports
config SERIAL
    bool
config SERIAL_BOOTLOADER_SIDECHANNEL
    bool
config SERIAL_BAUD
    depends on SERIAL
    int "Baud rate for serial port" if LOW_LEVEL_OPTIONS
    default 250000
    help
        Specify the baud rate of the serial port. This should be set
        to 250000. Read the FAQ before changing this value.

# Generic configuration options for USB
config USBSERIAL
    bool
config USBCANBUS
    bool
config USB
    bool
    default y if USBSERIAL || USBCANBUS
config USB_VENDOR_ID
    default 0x1d50
config USB_DEVICE_ID
    default 0x614e
config USB_SERIAL_NUMBER_CHIPID
    depends on USB && HAVE_CHIPID
    default y
config USB_SERIAL_NUMBER
    default "12345"
config USB_MANUFACTURER
    default "Klipper"
config USB_PRODUCT_FROM_MCU
    depends on USB
    default y
config USB_PRODUCT
    depends on USB
    default MCU

menu "USB ids"
    depends on USB && LOW_LEVEL_OPTIONS
comment "USB vendor/device ids are not used in USB to CAN bridge mode"
    depends on USBCANBUS
config USB_VENDOR_ID
    hex "USB vendor ID" if USBSERIAL
    help
        USB vendor id reported by the device. Not used in "USB to CAN
        bus bridge" mode - the bridge always reports the gs_usb id
        1d50:606f so that the kernel gs_usb driver binds to it. The
        value stored in .config has no effect on bridge builds.
config USB_DEVICE_ID
    hex "USB device ID" if USBSERIAL
    help
        USB device id reported by the device. Not used in "USB to CAN
        bus bridge" mode - the bridge always reports the gs_usb id
        1d50:606f so that the kernel gs_usb driver binds to it. The
        value stored in .config has no effect on bridge builds.
config USB_SERIAL_NUMBER_CHIPID
    bool "USB serial number from CHIPID" if HAVE_CHIPID
config USB_SERIAL_NUMBER
    string "USB serial number" if !USB_SERIAL_NUMBER_CHIPID
config USB_MANUFACTURER
    string "USB manufacturer"
config USB_PRODUCT_FROM_MCU
    bool "USB product from MCU name"
config USB_PRODUCT
    string "USB product" if !USB_PRODUCT_FROM_MCU
endmenu

menu "CAN bus UUID"
    depends on CANBUS && LOW_LEVEL_OPTIONS
config CAN_UUID_USE_CHIPID
    bool "CAN bus UUID Hash from CHIPID" if HAVE_CHIPID
config CAN_UUID_CUSTOM
    string "CAN bus UUID Hash" if !CAN_UUID_USE_CHIPID
endmenu

# Optional features that can be disabled (for devices with small flash sizes)
config WANT_ADC
    bool
    depends on HAVE_GPIO_ADC
    default y
config WANT_SPI
    bool
    default y if WANT_GPIO_SPI || WANT_SOFTWARE_SPI
    default n
config WANT_SOFTWARE_SPI
    bool
    depends on HAVE_GPIO
    default y if HAVE_GPIO
config WANT_I2C
    bool
    default y if WANT_GPIO_I2C || WANT_SOFTWARE_I2C
    default n
config WANT_SOFTWARE_I2C
    bool
    depends on HAVE_GPIO
    default y if HAVE_GPIO
config WANT_HARD_PWM
    bool
    depends on HAVE_GPIO_HARD_PWM
    default y
config WANT_BUTTONS
    bool
    depends on HAVE_GPIO
    default y
config WANT_TMCUART
    bool
    depends on HAVE_GPIO
    default y
config WANT_MODBUSUART
    bool
    depends on HAVE_GPIO
    default y
config WANT_NEOPIXEL
    bool
    depends on HAVE_GPIO
    default y
config WANT_PULSE_COUNTER
    bool
    depends on HAVE_GPIO
    default y
config WANT_ST7920
    bool
    depends on HAVE_GPIO
    default y
config WANT_HD44780
    bool
    depends on HAVE_GPIO
    default y
config WANT_ADXL345
    bool
    depends on WANT_SPI
    default y
config WANT_LIS2DW
    bool
    depends on WANT_SPI || WANT_I2C
    default y
config WANT_BMI160
    bool
    depends on WANT_SPI || WANT_I2C
    default y
config WANT_MPU9250
    bool
    depends on WANT_I2C
    default y
config WANT_ICM20948
    bool
    depends on WANT_I2C
    default y
config WANT_THERMOCOUPLE
    bool
    depends on WANT_SPI
    default y
config WANT_HX71X
    bool
    depends on HAVE_GPIO
    default y
config WANT_ADS1220
    bool
    depends on WANT_SPI
    default y
config WANT_ADS131M0X
    bool
    depends on WANT_SPI
    default y
config WANT_LDC1612
    bool
    depends on WANT_I2C
    default y
config WANT_SENSOR_ANGLE
    bool
    depends on HAVE_SPI
    default y
config WANT_GPIO_SPI
    bool
    depends on HAVE_GPIO && HAVE_GPIO_SPI
    default y
config WANT_GPIO_ADC
    bool
    depends on HAVE_GPIO && HAVE_GPIO_ADC
    default y
config WANT_GPIO_I2C
    bool
    depends on HAVE_GPIO && HAVE_GPIO_I2C
    default y
config NEED_SENSOR_BULK
    bool
    depends on WANT_ADXL345 || WANT_LIS2DW || WANT_BMI160 || WANT_MPU9250 || WANT_ICM20948 \
        || WANT_HX71X || WANT_ADS1220 || WANT_ADS131M0X \
        || WANT_LDC1612 || WANT_SENSOR_ANGLE
    default y
config NEED_LOAD_CELL_PROBE
    bool
    depends on WANT_HX71X || WANT_ADS1220 || WANT_ADS131M0X
    default y
config NEED_SOS_FILTER
    bool
    depends on NEED_LOAD_CELL_PROBE
    default y
config WANT_TRIGGER_ANALOG
    bool
    depends on WANT_ADC || WANT_HX71X || WANT_ADS1220 || WANT_ADS131M0X || WANT_LDC1612
    default y
config WANT_OPTIMIZE_SIZE
    bool
    default n

menu "Feature Configuration"
comment "Microcontroller interfaces"
config WANT_ADC
    bool "Support hardware ADC (analog to digital)"
    depends on HAVE_GPIO_ADC
config WANT_GPIO_SPI
    bool "Support hardware SPI communication"
    depends on HAVE_GPIO && HAVE_GPIO_SPI
config WANT_SOFTWARE_SPI
    bool "Support software SPI communication"
    depends on HAVE_GPIO
config WANT_GPIO_I2C
    bool "Support hardware I2C communication"
    depends on HAVE_GPIO && HAVE_GPIO_I2C
config WANT_SOFTWARE_I2C
    bool "Support software I2C communication"
    depends on HAVE_GPIO
config WANT_HARD_PWM
    bool "Support hardware PWM (pulse width modulation)"
    depends on HAVE_GPIO_HARD_PWM
config WANT_GPIO_BUTTONS
    bool "Support GPIO based button reading"
    depends on HAVE_GPIO

comment "----"
config WANT_TMCUART
    bool "Support Trinamic stepper motor driver UART communication"
    depends on HAVE_GPIO
config WANT_MODBUSUART
    bool "Support software Modbus RTU UART communication"
    depends on HAVE_GPIO
config WANT_NEOPIXEL
    bool "Support 'neopixel' type LED control"
    depends on HAVE_GPIO
config WANT_PULSE_COUNTER
    bool "Support measuring fan tachometer GPIO pins"
    depends on HAVE_GPIO
config WANT_FILAMENT_BLOCKAGE
    bool "Support filament blockage detection sensor"
    depends on HAVE_GPIO
config WANT_INDX_HEATER
    bool "Bondtech INDX Heater"
    depends on MACH_SAME51J19 && CLOCK_REF_X25M_XOSC0 && SAMD51_FREQ_120
    select HAVE_SOFTWARE_DIVIDE_REQUIRED

comment "LCD chips"
config WANT_ST7920
    bool "Support ST7920 LCD display"
    depends on HAVE_GPIO
config WANT_HD44780
    bool "Support HD44780 LCD display"
    depends on HAVE_GPIO

comment "Accelerometer chips"
    depends on WANT_SPI || WANT_I2C
config WANT_ADXL345
    bool "Support adxl accelerometers"
    depends on WANT_SPI
config WANT_LIS2DW
    bool "Support lis2dw and lis3dh 3-axis accelerometers"
    depends on WANT_SPI || WANT_I2C
config WANT_BMI160
    bool "Support BMI160 accelerometer"
    depends on WANT_SPI || WANT_I2C
config WANT_MPU9250
    bool "Support MPU accelerometers"
    depends on WANT_I2C
config WANT_ICM20948
    bool "Support ICM20948 accelerometer"
    depends on WANT_I2C

comment "External ADC type chips"
config WANT_THERMOCOUPLE
    bool "Support thermocouple MAX sensors"
    depends on WANT_SPI
config WANT_HX71X
    bool "Support HX711 and HX717 ADC chips"
    depends on HAVE_GPIO
config WANT_ADS1220
    bool "Support ADS 1220 ADC chip"
    depends on WANT_SPI
config WANT_ADS131M0X
    bool "Support ADS131M02 and ADS131M04 ADC chips"
    depends on WANT_SPI
config WANT_LDC1612
    bool "Support ldc1612 eddy current sensor chip"
    depends on WANT_I2C

config WANT_SENSOR_ANGLE
    bool "Support angle sensors"
    depends on WANT_SPI

comment "Compiler options"
config WANT_OPTIMIZE_SIZE
    bool "Optimize for code size (-Os) not speed (-O2)"
    default y if CONFIG_HAVE_LIMITED_CODE_SIZE
    default n
endmenu

# Generic configuration options for CANbus
config CANSERIAL
    bool
config CANBUS
    bool
    default y if CANSERIAL || USBCANBUS

# CAN FD mode (requires FDCAN hardware)
choice CANBUS_FD_CHOICE
    prompt "Enable CAN FD mode" if LOW_LEVEL_OPTIONS && CANBUS
    default CANBUS_FD_DISABLED
    help
        Enable CAN FD (Flexible Data-Rate) mode. This allows higher
        throughput (up to 64 bytes per frame vs 8) and faster data
        segment bitrates (up to 8Mbit/s). Requires FDCAN hardware
        (STM32 G4/H7/G0, SAME5x, SAME70, etc.) and a CAN FD
        capable transceiver. RP2040, STM32F1/F4 and older MCUs
        do not support CAN FD.

    config CANBUS_FD_DISABLED
        bool "Disabled (Classic CAN only)"
    config CANBUS_FD_ENABLED
        bool "Enabled (CAN FD)"
endchoice

config CANBUS_FD
    bool
    default y if CANBUS_FD_ENABLED
    default n if CANBUS_FD_DISABLED

# CAN bus arbitration segment speed
choice CANBUS_FREQUENCY_CHOICE
    prompt "CAN bus speed (arbitration bitrate)" if LOW_LEVEL_OPTIONS && CANBUS
    default CANBUS_FREQ_1M

    config CANBUS_FREQ_125K
        bool "125000 (125K)"
    config CANBUS_FREQ_250K
        bool "250000 (250K)"
    config CANBUS_FREQ_500K
        bool "500000 (500K)"
    config CANBUS_FREQ_1M
        bool "1000000 (1M)"

    # FDCAN hardware can also do these higher arbitration speeds
    config CANBUS_FREQ_2M
        bool "2000000 (2M)" if CANBUS_FD
    config CANBUS_FREQ_5M
        bool "5000000 (5M)" if CANBUS_FD
    config CANBUS_FREQ_8M
        bool "8000000 (8M)" if CANBUS_FD

    config CANBUS_FREQ_CUSTOM
        bool "Custom"
endchoice

config CANBUS_FREQUENCY_CUSTOM
    int "Custom CAN bus speed (arbitration)"
    default 1000000
    help
        Specify a custom arbitration bitrate in Hz.
        Common values: 125000, 250000, 500000, 1000000.

config CANBUS_FREQUENCY
    int
    default 125000 if CANBUS_FREQ_125K
    default 250000 if CANBUS_FREQ_250K
    default 500000 if CANBUS_FREQ_500K
    default 1000000 if CANBUS_FREQ_1M
    default 2000000 if CANBUS_FREQ_2M
    default 5000000 if CANBUS_FREQ_5M
    default 8000000 if CANBUS_FREQ_8M
    default 1000000 if CANBUS_FREQ_CUSTOM

# CAN FD data segment speed (only when CAN FD is enabled)
choice CANBUS_DATA_FREQUENCY_CHOICE
    prompt "CAN FD data segment bitrate" if LOW_LEVEL_OPTIONS && CANBUS && CANBUS_FD
    default CANBUS_DATA_FREQ_5M
    help
        CAN FD data segment bitrate. This is the high-speed portion
        of each CAN FD frame. Typically set to 4x-8x the arbitration
        rate for best throughput (e.g. 1M arbitration / 5M data).
        Must be >= arbitration bitrate. Requires a CAN FD capable
        transceiver and properly configured Linux socketcan interface
        (ip link set can0 type can ... dbitrate X fd on).

    config CANBUS_DATA_FREQ_1M
        bool "1000000 (1M)"
    config CANBUS_DATA_FREQ_2M
        bool "2000000 (2M)"
    config CANBUS_DATA_FREQ_5M
        bool "5000000 (5M)"
    config CANBUS_DATA_FREQ_8M
        bool "8000000 (8M)"
    config CANBUS_DATA_FREQ_CUSTOM
        bool "Custom"
endchoice

config CANBUS_DATA_FREQUENCY_CUSTOM
    int "Custom CAN FD data segment bitrate"
    default 5000000
    depends on CANBUS_FD

config CANBUS_DATA_FREQUENCY
    int
    default 1000000 if CANBUS_DATA_FREQ_1M
    default 2000000 if CANBUS_DATA_FREQ_2M
    default 5000000 if CANBUS_DATA_FREQ_5M
    default 8000000 if CANBUS_DATA_FREQ_8M
    default 5000000 if CANBUS_DATA_FREQ_CUSTOM

config CANBUS_FILTER
    bool
    default y if CANSERIAL
config CAN_UUID_USE_CHIPID
    depends on CANBUS && HAVE_CHIPID
    default y
config CAN_UUID_CUSTOM
    default "abc1234"

# Stepper optimizations
config INLINE_STEPPER_HACK
    # Enables gcc to inline stepper_event() into the main timer irq handler
    bool
    depends on HAVE_GPIO
    default y
config HAVE_STEPPER_OPTIMIZED_BOTH_EDGE
    bool
config WANT_STEPPER_OPTIMIZED_BOTH_EDGE
    bool "Optimize stepper code for 'step on both edges'" if LOW_LEVEL_OPTIONS
    depends on INLINE_STEPPER_HACK && HAVE_STEPPER_OPTIMIZED_BOTH_EDGE
    default y
    help
        Optimize the stepper code for Trinamic stepper motor drivers
        that are configured in UART or SPI mode (and thus can perform
        a step on both "edges" of the step pin).  Enabling this option
        typically improves the stepper cpu performance by about 20%
        when using these drivers.  If this option is disabled the code
        will instead deploy optimizations that improve the cpu
        performance by about 20% for traditional drivers (those that
        take a step only on the "rising" or "falling" level of the
        step pin).

# Support setting gpio state at startup
config INITIAL_PINS
    string "GPIO pins to set at micro-controller startup"
    depends on LOW_LEVEL_OPTIONS
    help
        One may specify a comma separated list of gpio pins to set
        during the micro-controller startup sequence. By default the
        pins will be set to output high - preface a pin with a '!'
        character to set that pin to output low.

# The HAVE_x options allow boards to disable support for some commands
# if the hardware does not support the feature.
config HAVE_GPIO
    bool
config HAVE_GPIO_ADC
    bool
config HAVE_GPIO_SPI
    bool
config HAVE_GPIO_SDIO
    bool
config HAVE_GPIO_I2C
    bool
config HAVE_GPIO_HARD_PWM
    bool
config HAVE_STRICT_TIMING
    bool
config HAVE_CHIPID
    bool
config HAVE_BOOTLOADER_REQUEST
    bool
config HAVE_LIMITED_CODE_SIZE
    bool
config HAVE_SOFTWARE_DIVIDE_REQUIRED
    bool

source "src/extras/Kconfig"
```
